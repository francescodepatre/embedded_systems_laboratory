## lab5/exercise2/build/mcuboot/Kconfig/boards/Kconfig.sysbuild
```kconfig
# Load Sysbuild board Kconfig descriptions.
osource "/opt/nordic/ncs/v3.0.0/zephyr/boards/nordic/thingy53/Kconfig.sysbuild"
```
